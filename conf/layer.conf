## conf/layer.conf
```bitbake
# We have a conf and classes directory, add to BBPATH
BBPATH .= ":${LAYERDIR}"

# We have recipes-* directories, add to BBFILES
BBFILES += "${LAYERDIR}/recipes-*/*/*.bb \
            ${LAYERDIR}/recipes-*/*/*.bbappend"

BBFILE_COLLECTIONS += "meta-test-layer"
BBFILE_PATTERN_meta-test-layer = "^${LAYERDIR}/"
BBFILE_PRIORITY_meta-test-layer = "6"

LAYERDEPENDS_meta-test-layer = "core"
LAYERSERIES_COMPAT_meta-test-layer = "dunfell"
```
